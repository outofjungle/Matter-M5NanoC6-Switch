## sdkconfig.defaults
```kconfig
# M5NanoC6 Matter Switch - SDK Configuration
# ESP32-C6 with Thread networking

# Target
CONFIG_IDF_TARGET="esp32c6"

# Flash size
CONFIG_ESPTOOLPY_FLASHSIZE_4MB=y

# Partition table
CONFIG_PARTITION_TABLE_CUSTOM=y
CONFIG_PARTITION_TABLE_CUSTOM_FILENAME="partitions.csv"
CONFIG_PARTITION_TABLE_OFFSET=0xC000

# BLE for commissioning
CONFIG_BT_ENABLED=y
CONFIG_BT_NIMBLE_ENABLED=y
CONFIG_BT_NIMBLE_EXT_ADV=n
CONFIG_BT_NIMBLE_HCI_EVT_BUF_SIZE=70
CONFIG_BT_NIMBLE_ENABLE_CONN_REATTEMPT=n
CONFIG_USE_BLE_ONLY_FOR_COMMISSIONING=n

# OpenThread for Thread networking
CONFIG_OPENTHREAD_ENABLED=y
CONFIG_OPENTHREAD_SRP_CLIENT=y
CONFIG_OPENTHREAD_DNS_CLIENT=y
CONFIG_OPENTHREAD_LOG_LEVEL_DYNAMIC=n
CONFIG_OPENTHREAD_LOG_LEVEL_NOTE=y
CONFIG_OPENTHREAD_CLI=n

# Disable WiFi (Thread-only device)
CONFIG_ENABLE_WIFI_STATION=n
CONFIG_ENABLE_WIFI_AP=n
CONFIG_ESP_WIFI_SOFTAP_SUPPORT=n

# LwIP config for OpenThread
CONFIG_LWIP_IPV6_AUTOCONFIG=y
CONFIG_LWIP_IPV6_NUM_ADDRESSES=8
CONFIG_LWIP_MULTICAST_PING=y
CONFIG_LWIP_HOOK_IP6_ROUTE_DEFAULT=y
CONFIG_LWIP_HOOK_ND6_GET_GW_DEFAULT=y

# MDNS
CONFIG_USE_MINIMAL_MDNS=n
CONFIG_ENABLE_EXTENDED_DISCOVERY=y

# OTA
CONFIG_ENABLE_OTA_REQUESTOR=y

# mbedTLS
CONFIG_MBEDTLS_HKDF_C=y

# libsodium
CONFIG_LIBSODIUM_USE_MBEDTLS_SHA=y

# FreeRTOS
CONFIG_FREERTOS_ENABLE_BACKWARD_COMPATIBILITY=y

# Matter Shell (for debugging)
CONFIG_ENABLE_CHIP_SHELL=y

# Disable ESP Insights (causes build issues with managed components)
CONFIG_ESP_INSIGHTS_ENABLED=n
```

## sdkconfig.defaults.release
```kconfig
# M5NanoC6 Matter Switch - Production SDK Configuration
# Use with: idf.py -D SDKCONFIG_DEFAULTS="sdkconfig.defaults;sdkconfig.defaults.release" build

# Disable debug shell (saves ~30KB RAM)
CONFIG_ENABLE_CHIP_SHELL=n

# Reduce log level to warnings only
CONFIG_LOG_DEFAULT_LEVEL_WARN=y

# Disable OpenThread CLI
CONFIG_OPENTHREAD_CLI=n

# Additional size optimizations
CONFIG_COMPILER_OPTIMIZATION_SIZE=y
CONFIG_COMPILER_OPTIMIZATION_ASSERTIONS_DISABLE=y

# Disable debug features
CONFIG_ESP_SYSTEM_PANIC_PRINT_HALT=y
CONFIG_HEAP_TRACING_OFF=y
```
